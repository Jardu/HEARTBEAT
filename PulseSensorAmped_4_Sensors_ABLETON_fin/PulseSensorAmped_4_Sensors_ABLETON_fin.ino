
/*
 * This code was modified by Jardu in summer 2019 based on the original code by Joel Murphy and Yury Gitman.
 * It allows you to send MIDI data generated by your heartbeat to a Digital Audio Workstation, i.e.Ableton.
 * Please make sure to check the pulsesensor website http://www.pulsesensor.com to learn more about this great project
 * developed by Joel Murphy and Yury Gitman.
 
   ----------------------  Notes ----------------------  ----------------------
  This code:
  1) Blinks an LED to two user's Live Heartbeat
  2) Determines BPMs for 4 users
  3) Generates MIDI Data based on your heartbeat 

  Read Me:
  https://github.com/WorldFamousElectronics/PulseSensor_Amped_Arduino/blob/master/README.md
  ----------------------       ----------------------  ----------------------
 */


/*  Pulse Sensor Multi Sensor

     by
     Joel Murphy and Yury Gitman   http://www.pulsesensor.com *   Updated Winter 2017

     World Famous Electronics llc.  Public Domain. 2017

*/



//  Variables
const int numPulseSensors = 4;
const int threshold = 530;
int pulsePin[numPulseSensors];                 // Pulse Sensor purple wire connected to analog pin 0
int blinkPin[numPulseSensors];                // pin to blink led at each beat
//int fadePin[numPulseSensors];                  // pin to do fancy classy fading blink at each beat
//int fadeRate[numPulseSensors];                 // used to fade LED on with PWM on fadePin



// Volatile Variables, used in the interrupt service routine!
volatile int BPM[numPulseSensors];                   // int that holds raw Analog in 0. updated every 2mS
volatile int Signal[numPulseSensors];                // holds the incoming raw data
volatile int IBI[numPulseSensors];             // int that holds the time interval between beats! Must be seeded!
volatile boolean Pulse[numPulseSensors];     // "True" when User's live heartbeat is detected. "False" when not a "live beat".
volatile boolean QS[numPulseSensors];        // becomes true when Arduoino finds a beat.

// Regards Serial OutPut  -- Set This Up to your needs
static boolean serialVisual = false;   // Set to 'false' by Default.  Re-set to 'true' to see Arduino Serial Monitor ASCII Visual Pulse

volatile int rate[numPulseSensors][10];                    // array to hold last ten IBI values
volatile unsigned long sampleCounter = 0;          // used to determine pulse timing
volatile unsigned long lastBeatTime[numPulseSensors];           // used to find IBI
volatile int P[numPulseSensors];                      // used to find peak in pulse wave, seeded
volatile int T[numPulseSensors];                     // used to find trough in pulse wave, seeded
volatile int thresh[numPulseSensors];                // used to find instant moment of heart beat, seeded
volatile int amp[numPulseSensors];                   // used to hold amplitude of pulse waveform, seeded
volatile boolean firstBeat[numPulseSensors];        // used to seed rate array so we startup with reasonable BPM
volatile boolean secondBeat[numPulseSensors];      // used to seed rate array so we startup with reasonable BPM


void setup() {

  setStuph();                       // initialize variables and pins

  Serial.begin(115200);             // we agree to talk fast!

  interruptSetup();                 // sets up to read Pulse Sensor signal every 2mS
}




void loop() {

 //serialOutput() ;

  for (int i = 0; i < numPulseSensors; i++) {
    if (QS[i] == true) {
      QS[i] = false;

      switch (i) {
        case  0: //A0                   // If necessary, change channel, note or velocity
          noteOn(0x96, 0x24, 0x7F);     // 0x96: CH07, 0x24: note 36, 0x7F: velocity 127 
          break;
        case  1: //A1
          noteOn(0x97, 0x40, 0x7F);     // 0x97: CH08, 0x35: note 53, 0x7F: velocity 127 
          break;        
        case  2: //A2
          noteOn(0x98, 0x46, 0x7F);     // 0x98: CH09, 0x46: note 70, 0x7F: velocity 127 
          break;
        case  3: //A3
          noteOn(0x99, 0x57, 0x7F);     // 0x99: CH10, 0x57: note 87, 0x7F: velocity 127 
          break;
         
        // add more if you need to here
        default:
          break;
        }
     
    }
  }

  //ledFadeToBeat();                      // Makes the LED Fade Effect Happen
  delay(20);                            //  take a break
}


// send MIDI data
void noteOn(int cmd, int pitch, int velocity) {
  Serial.write(cmd);
  Serial.write(pitch);
  Serial.write(velocity);
}

// INITIALIZE VARIABLES AND INPUT/OUTPUT PINS
void setStuph() {

/*
 * Initialize variables for each pulse sensor so we can find the beats
 */

  for (int i = 0; i < numPulseSensors; i++) {
    lastBeatTime[i] = 0;
    P[i] = T[i] = 512;
    amp[i] = 0;
    thresh[i] = threshold;
    amp[i] = 0;               // used to hold amplitude of pulse waveform, seeded
    firstBeat[i] = true;      // used to seed rate array so we startup with reasonable BPM
    secondBeat[i] = false;
    IBI[i] = 600;             // int that holds the time interval between beats! Must be seeded!
    Pulse[i] = false;         // "True" when User's live heartbeat is detected. "False" when not a "live beat".
    QS[i] = false;
    switch (i) {
      case  0:
        pulsePin[i] = 0;    // pulse pin Analog 0
        blinkPin[i] = 13;   // blink output for pulse 0
        //fadePin[i] = 5;     // fade output for pulse 0
        break;
      case  1:
        pulsePin[i] = 1;    // pulse pin Analog 1
        blinkPin[i] = 12;   // blink output for pulse 1
        break;
       case  2:
        pulsePin[i] = 2;    // pulse pin Analog 2
        blinkPin[i] = 11;   // blink output for pulse 2
        break;
       case  3:
        pulsePin[i] = 3;    // pulse pin Analog 3
        blinkPin[i] = 10;   // blink output for pulse 3
        break;
      // add more if you need to here
      default:
        break;
    }

    pinMode(blinkPin[i], OUTPUT);        // pin that will blink to your heartbeat!
    digitalWrite(blinkPin[i], LOW);

  }
}
